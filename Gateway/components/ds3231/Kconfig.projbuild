## Gateway/components/ds3231/Kconfig.projbuild
```kconfig
menu "DS3231 configuration"
    config DS3231_I2C_MASTER_SCL
        int "SCL GPIO Number"
        default 5 if IDF_TARGET_ESP8266
        default 6 if IDF_TARGET_ESP32C3
        default 19 if IDF_TARGET_ESP32 || IDF_TARGET_ESP32S2 || IDF_TARGET_ESP32S3
        help
            GPIO number for I2C Master clock line.

    config DS3231_I2C_MASTER_SDA
        int "SDA GPIO Number"
        default 4 if IDF_TARGET_ESP8266
        default 5 if IDF_TARGET_ESP32C3
        default 18 if IDF_TARGET_ESP32 || IDF_TARGET_ESP32S2 || IDF_TARGET_ESP32S3
        help
            GPIO number for I2C Master data line.
endmenu
```

## Node1/mcu1/components/sdcard/Kconfig.projbuild
```kconfig
menu "SDcard configuration"
    config PIN_NUM_MOSI
        int "MOSI GPIO Number"
        default 14
        help
            GPIO number for SPI master MOSI.

    config PIN_NUM_MISO
        int "MISO GPIO Number"
        default 38
        help
            GPIO number for SPI master MISO.

    config PIN_NUM_CLK
        int "CLK GPIO Number"
        default 21
        help
            GPIO number for SPI master CLK.

    config PIN_NUM_CS
        int "CS GPIO Number"
        default 13
        help
            GPIO number for SPI master CS.

endmenu
```
